/ {
    chosen {
        zmk,kscan = &kscan0;
    };

    leds: leds {
        compatible = "zmk,underglow";
        chain-length = <35>;   /* 29 per-key + 6 backlight per half */
        label = "rgb";
        /* DIN pin per metade (usaremos P0.15 as LED data pin) */
        io-channels = <&gpio0 15 GPIO_ACTIVE_HIGH>;
        brightness-step = <5>;
    };
};

&adafruit_feather_nrf52840 {
    compatible = "adafruit,feather-nrf52840";
};

/* matrix (usei os mapeamentos detectados na foto) */
&kscan0 {
    compatible = "zmk,keyboard-matrix";
    row-gpios = <&gpio0 11 &gpio0 10 &gpio0 9 &gpio0 8 &gpio0 6>;
    col-gpios = <&gpio0 17 &gpio0 20 &gpio0 22 &gpio0 24 &gpio1 0 &gpio1 2>;
    debounce-press-us = <20>;
    debounce-release-us = <20>;
};

/* Rotary encoder pins (one per half)
   enc_left: P0.05 / P0.04
   enc_right: P0.30 / P0.29
*/
rotary_encoders {
    compatible = "zmk,rotary-encoders";
    enc_left: encoder_left {
        gpios = <&gpio0 5 0 &gpio0 4 0>; /* dt style: pinA pinB */
    };
    enc_right: encoder_right {
        gpios = <&gpio0 30 0 &gpio0 29 0>;
    };
};
