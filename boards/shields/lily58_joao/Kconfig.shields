## boards/shields/lily58_joao/Kconfig.shields
```kconfig
# Custom shield for Lily58 João
config SHIELD_LILY58_JOAO
    bool "Lily58 João (nRF52840 Feather-clone)"
    select ZMK_KEYBOARD_SPLIT
    select ZMK_RGB
    select ZMK_RGB_UNDERGLOW
    select ZMK_ROTARY_ENCODER
```

## config/west.yml
```yaml
manifest:
  version: 0.13

  remotes:
    - name: zmkfirmware
      url-base: https://github.com/zmkfirmware

  projects:
    - name: zmk
      remote: zmkfirmware
      revision: main
      path: zmk

    - name: zephyr
      url: https://github.com/zephyrproject-rtos/zephyr
      revision: v3.5.0
      import: true

  self:
    path: config
```

## west.yml
```yaml
manifest:
  version: 0.13

  remotes:
    - name: zmkfirmware
      url-base: https://github.com/zmkfirmware
    - name: zephyrproject-rtos
      url-base: https://github.com/zephyrproject-rtos

  projects:
    - name: zephyr
      remote: zephyrproject-rtos
      revision: main
      path: zephyr
    - name: zmk
      remote: zmkfirmware
      revision: main
      path: zmk

  self:
    path: .
```
